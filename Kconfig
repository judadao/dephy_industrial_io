## Kconfig
```kconfig
mainmenu "Dephy Industrial IO"

source "Kconfig.zephyr"

config DEPHY_INDUSTRIAL_IO
	bool "Dephy industrial IO module"
	default y
```

## zephyr/Kconfig
```kconfig
menuconfig DEPHY_INDUSTRIAL_IO
	bool "Dephy industrial IO"
	default n
	help
	  Enable reusable industrial IO channel handling. Product apps provide
	  channel configuration and choose a platform driver.

if DEPHY_INDUSTRIAL_IO

config DEPHY_INDUSTRIAL_IO_ZEPHYR_GPIO
	bool "Enable Zephyr GPIO driver adapter"
	default n
	help
	  Build the Zephyr GPIO adapter. The first revision provides the module
	  hook point; board-specific GPIO mapping should be added in the product
	  or board layer.

config DEPHY_INDUSTRIAL_IO_ZEPHYR_SIM
	bool "Enable Zephyr software IO simulator"
	default n
	help
	  Build an in-memory Zephyr IO driver for ESP32 and native_sim firmware
	  tests. This does not touch real pins; product code or tests can change
	  raw channel values and exercise IO events, MQTT publishing, and command
	  handling on device.

config DEPHY_IO_MAX_CHANNELS
	int "Maximum IO channels"
	default 32
	range 1 256

endif
```
